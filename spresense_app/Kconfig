## spresense_app/Kconfig
```kconfig
config EXAMPLES_UWBINS
	tristate "6DoF tracker using UWB and IMU"
	default n
	---help---
		Enable the uwbins app

if EXAMPLES_UWBINS

config EXAMPLES_UWBINS_PROGNAME
	string "Program name"
	default "uwbins"
	---help---
		This is the name of the program that will be use when the NSH ELF
		program is installed.

config EXAMPLES_UWBINS_PRIORITY
	int "uwbins task priority"
	default 100

config EXAMPLES_UWBINS_STACKSIZE
	int "uwbins stack size"
	default 2048
## need to be modified
config EXAMPLES_SENSOR_STEP_COUNTER_ACCEL_WM_SIGNO
    int "Accelerator sensor watermark signal"
    default 14

config EXAMPLES_STEP_COUNTER_WALKING_STRIDE
	int "Stride length of walking state"
	default 60

config EXAMPLES_STEP_COUNTER_RUNNING_STRIDE
	int "Stride length of running state"
	default 80
##

endif
```
